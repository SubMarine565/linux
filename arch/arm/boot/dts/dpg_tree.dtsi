// SPDX-License-Identifier: GPL-2.0-or-later

#define LWBRIDGE_BASE 0xff200000

// Address spi master
#define OFFSET_SPI_MASTER 0x0
#define NUM_REGISTERS 0x13
#define BASE_SPI_MASTER (LWBRIDGE_BASE+OFFSET_SPI_MASTER)

/ {
	soc {
		DPG_SPI_MASTER_0: DPG_SPI0@DpgSpiMasterStartAddress {
			compatible = "dpg,spi_master";
			reg= <BASE_SPI_MASTER NUM_REGISTERS>;
		};
	};
};
